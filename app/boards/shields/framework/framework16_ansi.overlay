/*
 * Copyright (c) 2025 The ZMK Contributors
 *
 * SPDX-License-Identifier: MIT
 */

#include "framework16.dtsi"

#include <behaviors.dtsi>
#include <dt-bindings/led/led.h>
#include <dt-bindings/zmk/backlight.h>
#include <dt-bindings/zmk/ext_power.h>
#include <dt-bindings/zmk/keys.h>
#include <dt-bindings/zmk/matrix_transform.h>
#include <dt-bindings/zmk/rgb.h>

/ {
    // chosen {
    //     zmk,physical-layout = &matrix_layout;
    // };
};
