&i2c1 {
    status = "okay";

    touchpad: touchpad@2c {
        compatible = "zmk,hid-touchpad";
        status = "okay";
        reg = <0x2c>;
        dr-gpios = <&gpio0 15 (GPIO_ACTIVE_LOW | GPIO_PULL_UP)>;
        hid-descriptor-register = <0x20>;
        mouse-input-report-id = <1>;
        ptp-input-report-id = <4>;
        mouse-input-report-size = <8>;
        ptp-input-report-size = <29>;
        feature-report-ids = <2 3 5 6 7 10 11 65 66 67>;
        report-descriptor = [
          05 01          //   Usage Page (Generic Desktop Controls)
          09 02          //   Usage (Mouse)
          A1 01          //   Collection (Application)
          85 01          //     Report ID (0x01)
          09 01          //     Usage (Pointer)
          A1 00          //     Collection (Physical)
          05 09          //       Usage Page (Buttons)
          19 01          //       Usage Minimum (1)
          29 02          //       Usage Maximum (2)
          15 00          //       Logical Minimum (0)
          25 01          //       Logical Maximum (1)
          75 01          //       Report Size (1)
          95 02          //       Report Count (2)
          81 02          //       Input (Var)
          95 06          //       Report Count (6)
          81 03          //       Input (Const, Var)
          05 01          //       Usage Page (Generic Desktop Controls)
          09 30          //       Usage (Direction-X)
          09 31          //       Usage (Direction-Y)
          09 38          //       Usage (Wheel)
          15 81          //       Logical Minimum (-127)
          25 7F          //       Logical Maximum (127)
          75 08          //       Report Size (8)
          95 03          //       Report Count (3)
          81 06          //       Input (Var, Rel)
          05 0C          //       Usage Page (Consumer)
          0A 38 02       //       Usage (AC Pan)
          75 08          //       Report Size (8)
          95 01          //       Report Count (1)
          81 06          //       Input (Var, Rel)
          75 08          //       Report Size (8)
          95 03          //       Report Count (3)
          81 03          //       Input (Const, Var)
          C0             //     End Collection
          C0             //   End Collection
          05 0D          //   Usage Page (Digitizer)
          09 05          //   Usage (Touch Pad)
          A1 01          //   Collection (Application)
          85 04          //     Report ID (0x04)
          05 0D          //     Usage Page (Digitizer)
          09 22          //     Usage (Finger)
          A1 02          //     Collection (Logical)
          09 47          //       Usage (Confidence)
          09 42          //       Usage (Tip Switch)
          15 00          //       Logical Minimum (0)
          25 01          //       Logical Maximum (1)
          75 01          //       Report Size (1)
          95 02          //       Report Count (2)
          81 02          //       Input (Var)
          95 02          //       Report Count (2)
          81 03          //       Input (Const, Var)
          09 51          //       Usage (Contact ID)
          25 0F          //       Logical Maximum (15)
          75 04          //       Report Size (4)
          95 01          //       Report Count (1)
          81 02          //       Input (Var)
          05 01          //       Usage Page (Generic Desktop Controls)
          09 30          //       Usage (Direction-X)
          75 10          //       Report Size (16)
          55 0E          //       Unit Exponent (0x0E: -2)
          65 11          //       Unit (0x11)
          35 00          //       Physical Minimum (0)
          46 84 03       //       Physical Maximum (900)
          27 6D 04 00 00 //       Logical Maximum (1133)
          81 02          //       Input (Var)
          09 31          //       Usage (Direction-Y)
          46 76 02       //       Physical Maximum (630)
          27 19 03 00 00 //       Logical Maximum (793)
          81 02          //       Input (Var)
          C0             //     End Collection
          05 0D          //     Usage Page (Digitizer)
          09 22          //     Usage (Finger)
          A1 02          //     Collection (Logical)
          09 47          //       Usage (Confidence)
          09 42          //       Usage (Tip Switch)
          15 00          //       Logical Minimum (0)
          25 01          //       Logical Maximum (1)
          75 01          //       Report Size (1)
          95 02          //       Report Count (2)
          81 02          //       Input (Var)
          95 02          //       Report Count (2)
          81 03          //       Input (Const, Var)
          09 51          //       Usage (Contact ID)
          25 0F          //       Logical Maximum (15)
          75 04          //       Report Size (4)
          95 01          //       Report Count (1)
          81 02          //       Input (Var)
          05 01          //       Usage Page (Generic Desktop Controls)
          09 30          //       Usage (Direction-X)
          75 10          //       Report Size (16)
          55 0E          //       Unit Exponent (0x0E: -2)
          65 11          //       Unit (0x11)
          35 00          //       Physical Minimum (0)
          46 84 03       //       Physical Maximum (900)
          27 6D 04 00 00 //       Logical Maximum (1133)
          81 02          //       Input (Var)
          09 31          //       Usage (Direction-Y)
          46 76 02       //       Physical Maximum (630)
          27 19 03 00 00 //       Logical Maximum (793)
          81 02          //       Input (Var)
          C0             //     End Collection
          05 0D          //     Usage Page (Digitizer)
          09 22          //     Usage (Finger)
          A1 02          //     Collection (Logical)
          09 47          //       Usage (Confidence)
          09 42          //       Usage (Tip Switch)
          15 00          //       Logical Minimum (0)
          25 01          //       Logical Maximum (1)
          75 01          //       Report Size (1)
          95 02          //       Report Count (2)
          81 02          //       Input (Var)
          95 02          //       Report Count (2)
          81 03          //       Input (Const, Var)
          09 51          //       Usage (Contact ID)
          25 0F          //       Logical Maximum (15)
          75 04          //       Report Size (4)
          95 01          //       Report Count (1)
          81 02          //       Input (Var)
          05 01          //       Usage Page (Generic Desktop Controls)
          09 30          //       Usage (Direction-X)
          75 10          //       Report Size (16)
          55 0E          //       Unit Exponent (0x0E: -2)
          65 11          //       Unit (0x11)
          35 00          //       Physical Minimum (0)
          46 84 03       //       Physical Maximum (900)
          27 6D 04 00 00 //       Logical Maximum (1133)
          81 02          //       Input (Var)
          09 31          //       Usage (Direction-Y)
          46 76 02       //       Physical Maximum (630)
          27 19 03 00 00 //       Logical Maximum (793)
          81 02          //       Input (Var)
          C0             //     End Collection
          05 0D          //     Usage Page (Digitizer)
          09 22          //     Usage (Finger)
          A1 02          //     Collection (Logical)
          09 47          //       Usage (Confidence)
          09 42          //       Usage (Tip Switch)
          15 00          //       Logical Minimum (0)
          25 01          //       Logical Maximum (1)
          75 01          //       Report Size (1)
          95 02          //       Report Count (2)
          81 02          //       Input (Var)
          95 02          //       Report Count (2)
          81 03          //       Input (Const, Var)
          09 51          //       Usage (Contact ID)
          25 0F          //       Logical Maximum (15)
          75 04          //       Report Size (4)
          95 01          //       Report Count (1)
          81 02          //       Input (Var)
          05 01          //       Usage Page (Generic Desktop Controls)
          09 30          //       Usage (Direction-X)
          75 10          //       Report Size (16)
          55 0E          //       Unit Exponent (0x0E: -2)
          65 11          //       Unit (0x11)
          35 00          //       Physical Minimum (0)
          46 84 03       //       Physical Maximum (900)
          27 6D 04 00 00 //       Logical Maximum (1133)
          81 02          //       Input (Var)
          09 31          //       Usage (Direction-Y)
          46 76 02       //       Physical Maximum (630)
          27 19 03 00 00 //       Logical Maximum (793)
          81 02          //       Input (Var)
          C0             //     End Collection
          05 0D          //     Usage Page (Digitizer)
          09 22          //     Usage (Finger)
          A1 02          //     Collection (Logical)
          09 47          //       Usage (Confidence)
          09 42          //       Usage (Tip Switch)
          15 00          //       Logical Minimum (0)
          25 01          //       Logical Maximum (1)
          75 01          //       Report Size (1)
          95 02          //       Report Count (2)
          81 02          //       Input (Var)
          95 02          //       Report Count (2)
          81 03          //       Input (Const, Var)
          09 51          //       Usage (Contact ID)
          25 0F          //       Logical Maximum (15)
          75 04          //       Report Size (4)
          95 01          //       Report Count (1)
          81 02          //       Input (Var)
          05 01          //       Usage Page (Generic Desktop Controls)
          09 30          //       Usage (Direction-X)
          75 10          //       Report Size (16)
          55 0E          //       Unit Exponent (0x0E: -2)
          65 11          //       Unit (0x11)
          35 00          //       Physical Minimum (0)
          46 84 03       //       Physical Maximum (900)
          27 6D 04 00 00 //       Logical Maximum (1133)
          81 02          //       Input (Var)
          09 31          //       Usage (Direction-Y)
          46 76 02       //       Physical Maximum (630)
          27 19 03 00 00 //       Logical Maximum (793)
          81 02          //       Input (Var)
          C0             //     End Collection
          05 0D          //     Usage Page (Digitizer)
          09 54          //     Usage (Contact Count)
          15 00          //     Logical Minimum (0)
          25 05          //     Logical Maximum (5)
          75 08          //     Report Size (8)
          95 01          //     Report Count (1)
          81 02          //     Input (Var)
          05 09          //     Usage Page (Buttons)
          09 01          //     Usage (Button 1 (Primary))
          09 02          //     Usage (Button 2 (Secondary))
          09 03          //     Usage (Button 3 (Tertiary))
          15 00          //     Logical Minimum (0)
          25 01          //     Logical Maximum (1)
          75 01          //     Report Size (1)
          95 03          //     Report Count (3)
          81 02          //     Input (Var)
          95 05          //     Report Count (5)
          81 03          //     Input (Const, Var)
          05 0D          //     Usage Page (Digitizer)
          09 56          //     Usage (unk)
          55 0C          //     Unit Exponent (0x0C: -4)
          66 01 10       //     Unit (0x1001)
          35 00          //     Physical Minimum (0)
          47 FF FF 00 00 //     Physical Maximum (65535)
          15 00          //     Logical Minimum (0)
          27 FF FF 00 00 //     Logical Maximum (65535)
          75 10          //     Report Size (16)
          95 01          //     Report Count (1)
          81 02          //     Input (Var)
          05 0D          //     Usage Page (Digitizer)
          09 55          //     Usage (Maximum Contact Number)
          15 00          //     Logical Minimum (0)
          25 05          //     Logical Maximum (5)
          75 08          //     Report Size (8)
          95 01          //     Report Count (1)
          85 02          //     Report ID (0x02)
          B1 02          //     Feature (Var)
          05 0D          //     Usage Page (Digitizer)
          09 59          //     Usage (unk)
          15 00          //     Logical Minimum (0)
          25 01          //     Logical Maximum (1)
          75 08          //     Report Size (8)
          95 01          //     Report Count (1)
          85 06          //     Report ID (0x06)
          B1 02          //     Feature (Var)
          05 0D          //     Usage Page (Digitizer)
          09 60          //     Usage (unk)
          15 00          //     Logical Minimum (0)
          25 01          //     Logical Maximum (1)
          75 01          //     Report Size (1)
          95 01          //     Report Count (1)
          85 07          //     Report ID (0x07)
          B1 02          //     Feature (Var)
          95 07          //     Report Count (7)
          B1 03          //     Feature (Const, Var)
          06 00 FF       //     Usage Page (Vendor Defined)
          09 C5          //     Usage (unk)
          15 00          //     Logical Minimum (0)
          26 FF 00       //     Logical Maximum (255)
          75 08          //     Report Size (8)
          96 00 01       //     Report Count (256)
          85 0A          //     Report ID (0x0A)
          B1 02          //     Feature (Var)
          C0             //   End Collection
          05 0D          //   Usage Page (Digitizer)
          09 0E          //   Usage (unk)
          A1 01          //   Collection (Application)
          05 0D          //     Usage Page (Digitizer)
          09 22          //     Usage (Finger)
          A1 02          //     Collection (Logical)
          09 52          //       Usage (Input Mode)
          15 00          //       Logical Minimum (0)
          25 0A          //       Logical Maximum (10)
          75 08          //       Report Size (8)
          95 01          //       Report Count (1)
          85 03          //       Report ID (0x03)
          B1 02          //       Feature (Var)
          C0             //     End Collection
          05 0D          //     Usage Page (Digitizer)
          09 22          //     Usage (Finger)
          A1 00          //     Collection (Physical)
          09 57          //       Usage (unk)
          09 58          //       Usage (unk)
          15 00          //       Logical Minimum (0)
          25 01          //       Logical Maximum (1)
          75 01          //       Report Size (1)
          95 02          //       Report Count (2)
          85 05          //       Report ID (0x05)
          B1 02          //       Feature (Var)
          95 06          //       Report Count (6)
          B1 03          //       Feature (Const, Var)
          C0             //     End Collection
          C0             //   End Collection
          06 00 FF       //   Usage Page (Vendor Defined)
          09 01          //   Usage (unk)
          A1 01          //   Collection (Application)
          85 42          //     Report ID (0x42)
          09 06          //     Usage (unk)
          15 00          //     Logical Minimum (0)
          26 FF 00       //     Logical Maximum (255)
          75 08          //     Report Size (8)
          96 03 00       //     Report Count (3)
          B1 02          //     Feature (Var)
          85 41          //     Report ID (0x41)
          09 05          //     Usage (unk)
          15 00          //     Logical Minimum (0)
          26 FF 00       //     Logical Maximum (255)
          75 08          //     Report Size (8)
          96 00 01       //     Report Count (256)
          B1 02          //     Feature (Var)
          85 43          //     Report ID (0x43)
          09 06          //     Usage (unk)
          15 00          //     Logical Minimum (0)
          26 FF 00       //     Logical Maximum (255)
          75 08          //     Report Size (8)
          96 03 00       //     Report Count (3)
          B1 02          //     Feature (Var)
          85 0B          //     Report ID (0x0B)
          09 11          //     Usage (unk)
          15 00          //     Logical Minimum (0)
          26 FF 00       //     Logical Maximum (255)
          75 08          //     Report Size (8)
          96 01 00       //     Report Count (1)
          B1 02          //     Feature (Var)
          C0             //   End Collection
        ];
    };
};
