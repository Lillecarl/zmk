## app/boards/arm/daisy/Kconfig.board
```kconfig
# Daisy board configuration

# Copyright (c) 2016 Nordic Semiconductor ASA
# SPDX-License-Identifier: Apache-2.0

config BOARD_DAISY
	bool "Daisy"
	depends on SOC_NRF52840_QIAA
```

## app/boards/arm/daisy/daisy_defconfig
```kconfig
# SPDX-License-Identifier: Apache-2.0

CONFIG_SOC_SERIES_NRF52X=y
CONFIG_SOC_NRF52840_QIAA=y
CONFIG_BOARD_DAISY=y

# Enable MPU
CONFIG_ARM_MPU=y

# Enable hardware stack protection
CONFIG_HW_STACK_PROTECTION=y

# Enable RTT
CONFIG_USE_SEGGER_RTT=y

# enable GPIO
CONFIG_GPIO=y

# enable uart driver
CONFIG_SERIAL=y

# enable console
CONFIG_CONSOLE=y
CONFIG_UART_CONSOLE=y

CONFIG_ZMK_USB=y
CONFIG_ZMK_BLE=y

CONFIG_MPU_ALLOW_FLASH_WRITE=y
CONFIG_NVS=y
CONFIG_SETTINGS_NVS=y
CONFIG_FLASH=y
CONFIG_FLASH_PAGE_LAYOUT=y
CONFIG_FLASH_MAP=y

# nPM1300 PMIC
# CONFIG_GPIO_NPM1300=n
# CONFIG_LED_NPM1300=y
CONFIG_GPIO=y
CONFIG_REGULATOR=y
CONFIG_SENSOR=y
CONFIG_LED=y

# Only allow 3 profiles (3 LED indicators)
CONFIG_BT_MAX_CONN=3
CONFIG_BT_MAX_PAIRED=3
# Increase stack size, otherwise crashes when pressing pairing button to switch
# bluetooth profiles
CONFIG_INPUT_THREAD_STACK_SIZE=2048

CONFIG_ZMK_BATTERY_REPORTING=y
# Every 5 seconds
CONFIG_ZMK_BATTERY_REPORT_INTERVAL=5

CONFIG_BUILD_OUTPUT_UF2=y
CONFIG_USE_DT_CODE_PARTITION=y
```

## app/boards/arm/framework16/Kconfig.board
```kconfig
# Copyright (c) 2025 The ZMK Contributors
# SPDX-License-Identifier: Apache-2.0

config BOARD_FRAMEWORK16
    bool "Framework Laptop 16 Keyboard"
    depends on SOC_RP2040
```

## app/boards/flower/daisy/Kconfig.daisy
```kconfig
# Daisy board configuration

# Copyright (c) 2026 Framework Computer Inc
# SPDX-License-Identifier: Apache-2.0

config BOARD_DAISY
        select SOC_NRF52840_QIAA
        imply RETAINED_MEM
        imply RETENTION
        imply RETENTION_BOOT_MODE
```

## app/boards/flower/daisy/Kconfig.defconfig
```kconfig
# Daisy board configuration

# Copyright (c) 2026 Framework Computer Inc
# SPDX-License-Identifier: Apache-2.0

if BOARD_DAISY

if USB_DEVICE_STACK

config USB_NRFX
    default y

endif # USB_DEVICE_STACK

endif # BOARD_DAISY
```

## app/boards/flower/daisy/board.yml
```yaml
board:
  name: daisy
  full_name: daisy
  vendor: flower
  socs:
    - name: nrf52840
  revision:
    format: major.minor.patch
    default: 0.1.0
    revisions:
      # POC
      - name: 0.1.0
```

## app/boards/framework/framework16/Kconfig.defconfig
```kconfig
# Copyright (c) 2025 The ZMK Contributors
# SPDX-License-Identifier: MIT

if BOARD_FRAMEWORK16

config ZMK_KEYBOARD_NAME
    default "Framework 16"

config RP2_FLASH_W25Q080
    default y

endif # BOARD_FRAMEWORK16
```

## app/boards/framework/framework16/Kconfig.framework16
```kconfig
# Copyright (c) 2025 The ZMK Contributors
# SPDX-License-Identifier: Apache-2.0

config BOARD_FRAMEWORK16
	select SOC_RP2040

config LED_ROW_COUNT
	int "Number of rows in IS31FL3743 matrix"
	default 18
	help
	  Set this to match the number of SW LED sink connections
	  wired up to your IS31FL3743 LED driver. The sample will only attempt
	  to drive LEDs within this range.

config LED_COLUMN_COUNT
	int "Number of columns in IS31FL3743 matrix"
	default 11
	help
	  Set this to match the number of CS LED source connections wired up
	  to your IS31FL3743 LED driver. The sample will only attempt to drive
	  LEDs within this range.
```

## app/boards/kbdfans/tofu65/board.yml
```yaml
board:
  name: tofu65
  full_name: tofu65
  vendor: kbdfans
  socs:
    - name: rp2040
      variants:
        - name: zmk
```

## app/boards/moergo/glove80/board.yml
```yaml
boards:
  - name: glove80_rh
    full_name: glove80_rh
    vendor: moergo
    socs:
      - name: nrf52840
  - name: glove80_lh
    full_name: glove80_lh
    vendor: moergo
    socs:
      - name: nrf52840
```

## app/boards/native/native_sim/board.yml
```yaml
board:
  extend: native_sim
  variants:
    - name: zmk_display_testing
      qualifier: native
    - name: zmk_test_mock
      qualifier: native
    - name: zmk_test_input_mock
      qualifier: native
```

## app/boards/pierrechevalier83/ferris/board.yml
```yaml
board:
  name: ferris
  full_name: ferris
  vendor: pierrechevalier83
  socs:
    - name: stm32f072xb
      variants:
        - name: zmk
```

## app/boards/polarityworks/bt75/board.yml
```yaml
board:
  name: bt75
  full_name: bt75
  vendor: polarityworks
  socs:
    - name: nrf52840
      variants:
        - name: zmk
```

## app/boards/shields/daisy/Kconfig.defconfig
```kconfig
# Copyright (c) 2022 The ZMK Contributors
# SPDX-License-Identifier: MIT

if SHIELD_DAISY_BASE

config DAISY_FACTORY
    bool "Daisy factory-test HID interface"
    select HWINFO
    help
      Compile the vendor-defined factory-test HID interface (factory_hid.c),
      which lets the `aster` factory tool talk to the keyboard over USB with no
      custom OS driver. Enabled by the `daisy-factory` snippet, which also adds
      the required `factory_hid` devicetree node. Leave off for production
      firmware. Selects HWINFO for the device-id (FICR) read command.

config DAISY_FACTORY_RF
    bool "Daisy factory RF test modes (CE/FCC)"
    depends on DAISY_FACTORY && SOC_SERIES_NRF54L
    default y
    select DYNAMIC_INTERRUPTS
    select DYNAMIC_DIRECT_INTERRUPTS
    select BT_CTLR_DYNAMIC_INTERRUPTS if BT_LL_SW_SPLIT
    select NRFX_TIMER
    select NRFX_GPPI
    select CLOCK_CONTROL
    help
      Compile factory protocol group 0xB: Nordic's radio_test (unmodulated TX,
      modulated TX, duty-cycle TX, RX with a packet count, TX/RX sweeps) driven
      over the factory HID interface by `aster rf`. This is what the CE/FCC lab
      uses, and it ships in production firmware on purpose -- the lab cannot
      reflash a keyboard to a dedicated test image.

      Entering RF mode shuts the Bluetooth stack down to take the radio, and is
      one-way (recovery is a reboot). It is gated on factory mode, so a stray
      HID report cannot trigger it on a user's keyboard.

      BT_CTLR_DYNAMIC_INTERRUPTS is the load-bearing select: without it the
      controller claims the RADIO interrupt with a build-time IRQ_DIRECT_CONNECT
      that radio_test's irq_connect_dynamic() cannot take over. With it, the
      controller connects its ISRs at bt_enable() and releases them in
      ll_deinit(), which is exactly what that symbol exists for.

config RADIO_TEST_RX_TIMEOUT
    int "RF test: RX packet reception timeout, seconds"
    depends on DAISY_FACTORY_RF
    default 10
    help
      How long a counted RX run waits for its first packet before disabling the
      radio. Carried over from the radio_test sample's Kconfig, which the
      vendored driver in rf/ still reads.

config DAISY_TOUCHPAD_UPDATE
    bool "Converge the touchpad firmware to the image built into the keyboard"
    default y
    depends on ZMK_HID_TOUCHPAD
    select HID_TOUCHPAD_PIXART_UPDATE
    help
      Carry a PixArt PJP360 touchpad firmware release in the keyboard image
      (touchpad_firmware/, one file selected by DAISY_TOUCHPAD_FW_FILE) and,
      after boot, flash the pad whenever its version differs from the
      embedded one in either direction, or whenever it is running from ROM
      because its flash image is invalid. Pad firmware then follows keyboard
      firmware: the host-side fwupd path keeps working but is undone at the
      next boot unless it wrote the embedded version.

      The update runs on its own thread, claims the pad (host feature
      accesses fail with -EBUSY meanwhile) and takes a few seconds. It is
      skipped in factory mode and, unless the pad is in ROM mode, on battery
      below DAISY_TOUCHPAD_UPDATE_MIN_SOC. See
      aster plans/touchpad-firmware-self-update.md.

config DAISY_TOUCHPAD_FW_FILE
    string "Touchpad firmware file to embed (in touchpad_firmware/)"
    depends on DAISY_TOUCHPAD_UPDATE
    default "Daisy_FW1204_20260907_CAB.bin"
    help
      Vendor FWHD file to embed. The build parses and CRC-checks it
      (touchpad_firmware/gen_tp_fw.py) and fails on a malformed file.

config DAISY_TOUCHPAD_UPDATE_MIN_SOC
    int "Minimum battery SOC to start a touchpad update when not USB-powered"
    depends on DAISY_TOUCHPAD_UPDATE
    range 0 100
    default 30
    help
      Below this the boot-time version convergence is skipped (retried at the
      next boot). Not applied when the pad is in ROM mode: an invalid image
      makes the pad useless, so recovery always runs.

config DAISY_CHARGE_TIMEOUT_RECOVERY
    bool "Recover from nPM1300 charge safety-timer expiry"
    default y
    help
      The nPM1300 charge safety timer (~7 h) is shorter than a full 0.2C
      charge of the pack (~7.3 h), so every deep charge latches a
      CHARGETIMEOUT error at ~93-95% SOC and stops until a VBUS replug.
      This module polls the charger while USB-powered and, when that error
      latches, clears it and re-enables charging (the datasheet-documented
      recovery), bounded by a 12 h active-charging budget per plug-in so a
      degenerate cell still latches off. Set to n to reproduce the raw
      latch behavior for lab A/B testing. See
      aster/issues/charge-stops-early-safety-timer.md.

config DAISY_BATTERY_CUTOFF
    bool "Low-battery cutoff (nPM1300 ship mode)"
    default y
    depends on ZMK_USB
    help
      Stop discharging the pack before it reaches its own protection trip.
      The cell spec (PACK-GPT-RD.SPC-010123-FT612178PA-1200-FA322 §3.5) gives
      a 3.0 V discharge cut-off and the pack's CM1006-DAA protection IC trips
      at 2.92/3.00/3.08 V; with both bucks configured for 3.3 V the rails just
      follow the cell down past that, which is the over-discharge the pack
      vendor reported.

      The nPM1300 cannot do this in hardware here: it has no battery UVLO
      (PS §6.2.2) and its POF comparator only signals on a PMIC GPIO, and
      GPIO0..GPIO4 are unconnected on dvt1/dvt2. So battery_cutoff.c polls
      VBAT and, once it holds at/below the threshold, enters ship mode
      (370 nA, battery disconnected from the system). Recovery is a USB
      plug-in.

      Set to n only for lab work that deliberately runs a pack down.

if DAISY_BATTERY_CUTOFF

config DAISY_BATTERY_CUTOFF_MV
    int "Low-battery cutoff threshold, mV"
    default 3200
    range 3100 3600
    help
      VBAT at or below this, held for DAISY_BATTERY_CUTOFF_CONSECUTIVE polls
      with USB unplugged, enters ship mode. 3200 mV is the pack vendor's
      requested floor and leaves ~120 mV of margin over the protection IC's
      3.08 V worst-case trip. A build assert keeps it above 3080 mV.

config DAISY_BATTERY_WARN_MV
    int "Low-battery warning threshold, mV"
    default 3350
    help
      VBAT at or below this blinks the status LED red. Must be above
      DAISY_BATTERY_CUTOFF_MV.

config DAISY_BATTERY_BACKLIGHT_SHED_MV
    int "Backlight shed threshold, mV"
    default 3400
    help
      VBAT at or below this turns the backlight off. It is the largest single
      load, so shedding it buys real runtime and slows the approach to the
      cutoff. Must not be below DAISY_BATTERY_WARN_MV.

config DAISY_BATTERY_CUTOFF_HYSTERESIS_MV
    int "Recovery hysteresis, mV"
    default 100
    help
      How far above a threshold VBAT must climb before that step is undone.
      Applies to the warning and the backlight shed; the cutoff itself is
      terminal.

config DAISY_BATTERY_CUTOFF_CONSECUTIVE
    int "Consecutive samples below the cutoff before acting"
    default 3
    range 2 60
    help
      VBAT sags hard on BLE TX bursts and with the backlight on, so a single
      reading below the threshold can happen with charge to spare. Requiring
      several consecutive polls turns the check into a sustained-undervoltage
      test. At the default poll interval this is 15 seconds.

config DAISY_BATTERY_CUTOFF_POLL_SEC
    int "VBAT poll interval, seconds"
    default 5
    range 5 600
    help
      One charger read per poll; at 5 s that is a negligible load. Together
      with DAISY_BATTERY_CUTOFF_CONSECUTIVE this sets how long VBAT must stay
      below the cutoff before the board turns itself off: 5 s x 3 = 15 s.

endif # DAISY_BATTERY_CUTOFF

config ZMK_KEYBOARD_NAME
    # TODO: Full name (Current limit is 16 - BT_DEVICE_NAME_MAX)
    #        1234567890123456
    default "Touchpad KB"

# Device-identity overrides (USB iProduct, BLE DIS PnP VID/PID, DIS manufacturer)
# live in daisy.conf as hard CONFIG_ assignments — a Kconfig.defconfig `default`
# here does NOT override the defaults ZMK already sets in app/Kconfig.

config ZMK_PM_SOFT_OFF
    default y if BOARD_NRF52840DK_NRF52840

endif
```

## app/boards/shields/daisy/Kconfig.shield
```kconfig
# Copyright (c) 2022 The ZMK Contributors
# SPDX-License-Identifier: MIT

config SHIELD_DAISY_BASE
    bool

config SHIELD_DAISY
    def_bool $(shields_list_contains,daisy)
    select SHIELD_DAISY_BASE

config SHIELD_DAISY_SPLIT_LEFT
    def_bool $(shields_list_contains,daisy_split_left)
    select SHIELD_DAISY_BASE
    select ZMK_SPLIT
    select ZMK_SPLIT_ROLE_CENTRAL

config SHIELD_DAISY_SPLIT_RIGHT
    def_bool $(shields_list_contains,daisy_split_right)
    select SHIELD_DAISY_BASE
    select ZMK_SPLIT
```

## app/boards/shields/framework/Kconfig.defconfig
```kconfig
# Copyright (c) 2025 The ZMK Contributors
# SPDX-License-Identifier: MIT

if SHIELD_FRAMEWORK16_ANSI

config ZMK_KEYBOARD_NAME
    default "Framework Laptop 16 - ANSI Keyboard"

config ZMK_BACKLIGHT
    select LED
    select LED_PWM

endif
```

## app/boards/shields/framework/Kconfig.shield
```kconfig
# Copyright (c) 2025 The ZMK Contributors
# SPDX-License-Identifier: MIT

config SHIELD_FRAMEWORK16_ANSI
    def_bool $(shields_list_contains,framework16_ansi)

config SHIELD_FRAMEWORK16_MACROPAD
    def_bool $(shields_list_contains,framework16_numpad)
```
