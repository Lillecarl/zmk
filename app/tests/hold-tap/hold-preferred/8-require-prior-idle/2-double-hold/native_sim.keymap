#include <dt-bindings/zmk/keys.h>
#include <behaviors.dtsi>
#include <dt-bindings/zmk/input_mock.h>
#include "../behavior_keymap.dtsi"

&mock_input {
    events = <
        /* hold the first mod tap */
        ZMK_INPUT_MOCK_PRESS(0,0,400)
        /* hold the second mod tap */
        ZMK_INPUT_MOCK_PRESS(0,1,400)
        /* press the normal key */
        ZMK_INPUT_MOCK_PRESS(1,0,10)
        ZMK_INPUT_MOCK_RELEASE(1,0,10)

        /* release the hold taps */
        ZMK_INPUT_MOCK_RELEASE(0,0,10)
        ZMK_INPUT_MOCK_RELEASE(0,1,10)
    >;
};
