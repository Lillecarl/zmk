#include <dt-bindings/zmk/keys.h>
#include <behaviors.dtsi>
#include <dt-bindings/zmk/input_mock.h>
#include "../behavior_keymap.dtsi"

&mock_input {
    events = <
        /* tap */
        ZMK_INPUT_MOCK_PRESS(0,0,10)
        ZMK_INPUT_MOCK_RELEASE(0,0,250)
        /* normal quick tap */
        ZMK_INPUT_MOCK_PRESS(0,0,400)
        ZMK_INPUT_MOCK_RELEASE(0,0,400)
        /* hold */
        ZMK_INPUT_MOCK_PRESS(0,0,400)
        ZMK_INPUT_MOCK_PRESS(1,0,10)
        ZMK_INPUT_MOCK_RELEASE(1,0,10)
        ZMK_INPUT_MOCK_RELEASE(0,0,400)
        /* require-prior-idle */
        ZMK_INPUT_MOCK_PRESS(1,0,10)
        ZMK_INPUT_MOCK_PRESS(0,0,400)
        ZMK_INPUT_MOCK_RELEASE(1,0,10)
        ZMK_INPUT_MOCK_RELEASE(0,0,10)
    >;
};
