#include <dt-bindings/zmk/keys.h>
#include <behaviors.dtsi>
#include <dt-bindings/zmk/input_mock.h>
#include "../behavior_keymap.dtsi"

&mock_input {
    events = <
        ZMK_INPUT_MOCK_PRESS(1,1,10) /*ctrl*/
        ZMK_INPUT_MOCK_PRESS(0,0,50)  /*mt f-shift */
        ZMK_INPUT_MOCK_RELEASE(1,1,300)
        /*timer*/
        ZMK_INPUT_MOCK_RELEASE(0,0,10)
    >;
};