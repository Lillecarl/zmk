#include <dt-bindings/zmk/keys.h>
#include <behaviors.dtsi>
#include <dt-bindings/zmk/input_mock.h>
#include "../behavior_keymap.dtsi"

&mock_input {
    events = <
        ZMK_INPUT_MOCK_PRESS(1,0,10) /* d */
        ZMK_INPUT_MOCK_PRESS(0,0,100) /* mt f-shift */
        ZMK_INPUT_MOCK_RELEASE(1,0,400)
        ZMK_INPUT_MOCK_RELEASE(0,0,10)
    >;
};