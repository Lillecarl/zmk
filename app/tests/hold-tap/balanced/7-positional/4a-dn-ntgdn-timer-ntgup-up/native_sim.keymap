#include <dt-bindings/zmk/keys.h>
#include <behaviors.dtsi>
#include <dt-bindings/zmk/input_mock.h>
#include "../behavior_keymap.dtsi"

&mock_input {
    events = <
        ZMK_INPUT_MOCK_PRESS(0,0,200)
        ZMK_INPUT_MOCK_PRESS(1,1,200) // non trigger key
        /* timer fires */
        ZMK_INPUT_MOCK_RELEASE(1,1,10)
        ZMK_INPUT_MOCK_RELEASE(0,0,10)
    >;
};