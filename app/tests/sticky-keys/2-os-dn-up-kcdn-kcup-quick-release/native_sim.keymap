#include <dt-bindings/zmk/keys.h>
#include <behaviors.dtsi>
#include <dt-bindings/zmk/input_mock.h>
#include "../behavior_keymap.dtsi"

&sk {
    quick-release;
};

&mock_input {
    events = <
        ZMK_INPUT_MOCK_PRESS(0,0,10)
        ZMK_INPUT_MOCK_RELEASE(0,0,10)
        ZMK_INPUT_MOCK_PRESS(1,0,10)
        /* second key is pressed shortly after the first. It should not be capitalized. */
        ZMK_INPUT_MOCK_PRESS(1,1,10)
        ZMK_INPUT_MOCK_RELEASE(1,0,10)
        ZMK_INPUT_MOCK_RELEASE(1,1,10)

        /* repeat test to check if cleanup is done correctly */
        ZMK_INPUT_MOCK_PRESS(0,0,10)
        ZMK_INPUT_MOCK_RELEASE(0,0,10)
        ZMK_INPUT_MOCK_PRESS(1,0,10)
        ZMK_INPUT_MOCK_RELEASE(1,0,10)
    >;
};