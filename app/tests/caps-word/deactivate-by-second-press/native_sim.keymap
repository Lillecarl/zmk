#include <dt-bindings/zmk/keys.h>
#include <behaviors.dtsi>
#include <dt-bindings/zmk/input_mock.h>
#include "../behavior_keymap.dtsi"

&mock_input {
    events = <
    ZMK_INPUT_MOCK_PRESS(0,0,10000)
    ZMK_INPUT_MOCK_RELEASE(0,0,10)
    ZMK_INPUT_MOCK_PRESS(0,1,30)
    ZMK_INPUT_MOCK_RELEASE(0,1,30)
    ZMK_INPUT_MOCK_PRESS(0,0,10)
    ZMK_INPUT_MOCK_RELEASE(0,0,30)
    ZMK_INPUT_MOCK_PRESS(0,1,30)
    ZMK_INPUT_MOCK_RELEASE(0,1,1000)
    >;
};