#include "../behavior_keymap.dtsi"

&mock_input {
    events = <
        /* BL_ON */
        ZMK_INPUT_MOCK_PRESS(1,0,10)
        ZMK_INPUT_MOCK_RELEASE(1,0,10)
        /* BL_OFF */
        ZMK_INPUT_MOCK_PRESS(1,1,10)
        ZMK_INPUT_MOCK_RELEASE(1,1,10)
    >;
};
