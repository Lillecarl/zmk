#include "../behavior_keymap.dtsi"

&mock_input {
    events = <
        /* BL_DEC */
        ZMK_INPUT_MOCK_PRESS(0,1,10)
        ZMK_INPUT_MOCK_RELEASE(0,1,10)
        /* BL_DEC */
        ZMK_INPUT_MOCK_PRESS(0,1,10)
        ZMK_INPUT_MOCK_RELEASE(0,1,10)
        /* BL_ON */
        ZMK_INPUT_MOCK_PRESS(1,0,10)
        ZMK_INPUT_MOCK_RELEASE(1,0,10)
        /* BL_OFF */
        ZMK_INPUT_MOCK_PRESS(1,1,10)
        ZMK_INPUT_MOCK_RELEASE(1,1,10)
        /* BL_INC */
        ZMK_INPUT_MOCK_PRESS(0,0,10)
        ZMK_INPUT_MOCK_RELEASE(0,0,10)
        /* BL_INC */
        ZMK_INPUT_MOCK_PRESS(0,0,10)
        ZMK_INPUT_MOCK_RELEASE(0,0,10)
        /* BL_OFF */
        ZMK_INPUT_MOCK_PRESS(1,1,10)
        ZMK_INPUT_MOCK_RELEASE(1,1,10)
        /* BL_DEC */
        ZMK_INPUT_MOCK_PRESS(0,1,10)
        ZMK_INPUT_MOCK_RELEASE(0,1,10)
        /* BL_DEC */
        ZMK_INPUT_MOCK_PRESS(0,1,10)
        ZMK_INPUT_MOCK_RELEASE(0,1,10)
        /* BL_DEC */
        ZMK_INPUT_MOCK_PRESS(0,1,10)
        ZMK_INPUT_MOCK_RELEASE(0,1,10)
        /* BL_INC */
        ZMK_INPUT_MOCK_PRESS(0,0,10)
        ZMK_INPUT_MOCK_RELEASE(0,0,10)
    >;
};
