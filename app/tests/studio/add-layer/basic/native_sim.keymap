#include <dt-bindings/zmk/keys.h>
#include <behaviors.dtsi>
#include <dt-bindings/zmk/input_mock.h>
#include "../behavior_keymap.dtsi"

// Test adding a layer, setting a binding, activating it, and pressing the binding
&mock_input {
    events = <
    // add a new layer
    ZMK_INPUT_MOCK_PRESS(0,0,10)
    ZMK_INPUT_MOCK_RELEASE(0,0,10)
    // set binding A at layer 1, position 0
    ZMK_INPUT_MOCK_PRESS(0,1,10)
    ZMK_INPUT_MOCK_RELEASE(0,1,10)
    // activate layer 1 with momentary
    ZMK_INPUT_MOCK_PRESS(1,0,10)
    // press position 0 on new layer (should be A)
    ZMK_INPUT_MOCK_PRESS(0,0,10)
    ZMK_INPUT_MOCK_RELEASE(0,0,10)
    // release momentary layer 1
    ZMK_INPUT_MOCK_RELEASE(1,0,10)
    >;
};
