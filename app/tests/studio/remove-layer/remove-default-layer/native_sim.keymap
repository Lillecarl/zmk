#include <dt-bindings/zmk/keys.h>
#include <behaviors.dtsi>
#include <dt-bindings/zmk/input_mock.h>
#include "../behavior_keymap.dtsi"

// Test removing layer 0: layer 1 becomes bottom layer
&mock_input {
    events = <
    // toggle layer 1 on
    ZMK_INPUT_MOCK_PRESS(0,1,10)
    ZMK_INPUT_MOCK_RELEASE(0,1,10)
    // remove layer 0
    ZMK_INPUT_MOCK_PRESS(1,0,10)
    ZMK_INPUT_MOCK_RELEASE(1,0,10)
    // press position 0,0 - should output B (layer 1)
    ZMK_INPUT_MOCK_PRESS(0,0,10)
    ZMK_INPUT_MOCK_RELEASE(0,0,10)
    // try to toggle layer 1 off
    ZMK_INPUT_MOCK_PRESS(0,1,10)
    ZMK_INPUT_MOCK_RELEASE(0,1,10)
    // press position 0,0 - should output B
    // (layer 1 is now the bottom layer, so shouldn't be disabled)
    ZMK_INPUT_MOCK_PRESS(0,0,10)
    ZMK_INPUT_MOCK_RELEASE(0,0,10)
    >;
};
