#include "../behavior_keymap.dtsi"

&mock_input {
    events = < ZMK_INPUT_MOCK_PRESS(1,0,10) ZMK_INPUT_MOCK_PRESS(0,0,10)
    ZMK_INPUT_MOCK_PRESS(1,1,8000)
    >;
};

&mock_encoder {
    events = <18>;
};
