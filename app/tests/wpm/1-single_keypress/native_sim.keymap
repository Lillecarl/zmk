#include "../behavior_keymap.dtsi"

&mock_input {
    events = <
        ZMK_INPUT_MOCK_PRESS(0,0,10)
        ZMK_INPUT_MOCK_RELEASE(0,0,10)
        /* Wait for the worker to trigger and reset after 5 seconds, followed by a 0 at 6 seconds */
        ZMK_INPUT_MOCK_PRESS(0,0,6000)
    >;
};