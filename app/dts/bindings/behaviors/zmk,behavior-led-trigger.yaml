## app/dts/bindings/behaviors/zmk,behavior-led-trigger.yaml
```yaml
description: Custom LED Trigger Behavior

compatible: "zmk,behavior-led-trigger"

include: one_param.yaml
```

## app/dts/bindings/behaviors/zmk,behavior-pairing.yaml
```yaml
# Copyright (c) 2026 Framework Computer Inc
# SPDX-License-Identifier: MIT

description: |
  Daisy pairing-button Behavior. param1 selects the action: 0 = next BLE
  profile, 1 = clear the active profile's bond. Both are ignored while BLE is
  off (protocol switch in the wired position).

compatible: "zmk,behavior-pairing"

include: one_param.yaml
```

## app/dts/bindings/behaviors/zmk,behavior-touchpad-power.yaml
```yaml
# Copyright (c) 2026 Framework Computer Inc
# SPDX-License-Identifier: MIT

description: Daisy touchpad user enable/disable Behavior

compatible: "zmk,behavior-touchpad-power"

include: one_param.yaml
```

## app/dts/bindings/input/zmk,input-sideband-behaviors.yaml
```yaml
# Copyright (c) 2023-2026, The ZMK Contributors
# SPDX-License-Identifier: MIT

description: |
  Input sideband behavior runner. Listens to an input device reporting
  (ABS_X=col, ABS_Y=row, BTN_TOUCH=pressed) and triggers the matching
  behavior binding on press/release. Only basic system behaviors should
  be used since no keymap processing occurs (avoid tap-holds, sticky
  keys, etc. as sideband behaviors).

compatible: "zmk,input-sideband-behaviors"

properties:
  input:
    type: phandle
    required: true
    description: |
      The input device whose events are matched against the child entries.

child-binding:
  description: "A sideband behavior tied to a row/column pair."

  properties:
    row:
      type: int
      default: 0
    column:
      type: int
      required: true
    bindings:
      type: phandle-array
      required: true
```

## app/module/boards/keycapsss/puchi_ble/board.yml
```yaml
board:
  name: puchi_ble
  full_name: puchi_ble
  vendor: keycapsss
  socs:
    - name: nrf52840
```

## app/module/boards/makerdiary/nrf52840_m2/board.yml
```yaml
board:
  name: nrf52840_m2
  full_name: nrf52840_m2
  vendor: makerdiary
  socs:
    - name: nrf52840
```

## app/module/drivers/input/Kconfig
```kconfig
config ZMK_INPUT_MOCK
    bool "Input Mock"
    default y
    depends on INPUT
    depends on DT_HAS_ZMK_INPUT_MOCK_ENABLED

config ZMK_INPUT_GPIO_MATRIX
    bool "GPIO matrix input driver"
    default y
    depends on DT_HAS_ZMK_INPUT_GPIO_MATRIX_ENABLED
    select INPUT
    select GPIO
    select ZMK_DEBOUNCE

config ZMK_INPUT_GPIO_DIRECT
    bool "Direct GPIO input driver"
    default y
    depends on DT_HAS_ZMK_INPUT_GPIO_DIRECT_ENABLED
    select INPUT
    select GPIO
    select ZMK_DEBOUNCE

config ZMK_INPUT_COMPOSITE
    bool "Composite input driver"
    default y
    depends on DT_HAS_ZMK_INPUT_COMPOSITE_ENABLED
    select INPUT

config ZMK_INPUT_DEGHOST
    bool "Deghost input driver"
    default y
    depends on DT_HAS_ZMK_INPUT_DEGHOST_ENABLED
    select INPUT

if ZMK_INPUT_GPIO_DIRECT

config ZMK_INPUT_DIRECT_POLLING
    bool "Poll for key event triggers instead of using interrupts on direct GPIO boards."

endif # ZMK_INPUT_GPIO_DIRECT

if ZMK_INPUT_GPIO_MATRIX

config ZMK_INPUT_MATRIX_POLLING
    bool "Poll for key event triggers instead of using interrupts on matrix boards."

config ZMK_INPUT_MATRIX_WAIT_BEFORE_INPUTS
    int "Microseconds to wait before reading inputs after an output set active"
    default 0
    help
        When iterating over each output to drive it active, read inputs, then set
        inactive again, some boards may take time for output to propagate to the
        inputs. In that scenario, set this value to a positive value to configure
        the number of microseconds to wait after setting an output active before
        reading the inputs for their active state.

config ZMK_INPUT_MATRIX_WAIT_BETWEEN_OUTPUTS
    int "Microseconds to wait between each output when scanning"
    default 1 if SOC_RP2040 || SOC_SERIES_RP2350
    default 0
    help
        When iterating over each output to drive it active, read inputs, then set
        inactive again, some boards may take time for the previous output to
        "settle" before reading inputs for the next active output column. In that
        scenario, set this value to a positive value to configure the number of
        microseconds to wait after reading each column of keys.

endif # ZMK_INPUT_GPIO_MATRIX

if ZMK_INPUT_GPIO_MATRIX || ZMK_INPUT_GPIO_DIRECT

config ZMK_INPUT_DEBOUNCE_PRESS_MS
    int "Debounce time for key press in milliseconds."
    default -1
    help
        Global debounce time for key press in milliseconds.
        If this is -1, the debounce time is controlled by the debounce-press-ms
        Devicetree property, which defaults to 5 ms. Otherwise this overrides the
        debounce time for all input GPIO drivers to the chosen value.

config ZMK_INPUT_DEBOUNCE_RELEASE_MS
    int "Debounce time for key release in milliseconds."
    default -1
    help
        Global debounce time for key release in milliseconds.
        If this is -1, the debounce time is controlled by the debounce-release-ms
        Devicetree property, which defaults to 5 ms. Otherwise this overrides the
        debounce time for all input GPIO drivers to the chosen value.

endif # ZMK_INPUT_GPIO_MATRIX || ZMK_INPUT_GPIO_DIRECT
```

## app/module/dts/bindings/input/zmk,input-composite.yaml
```yaml
# Copyright (c) 2026 The ZMK Contributors
# SPDX-License-Identifier: MIT

description: |
  Compose multiple input devices (each emitting ABS_X/ABS_Y/BTN_TOUCH key
  events) into a single logical input device with per-child row/column
  offsets.

  The composite device re-emits key events with offsets applied. Point
  chosen { zmk,matrix-input = ...; } (or a physical layout's `input`
  property) at the composite node.

compatible: "zmk,input-composite"

include: base.yaml

child-binding:
  description: A child input device with row/column offsets.

  properties:
    input:
      type: phandle
      required: true
      description: The input device whose events are re-emitted with offsets.
    row-offset:
      type: int
      default: 0
    col-offset:
      type: int
      default: 0
    column-offset:
      type: int
      default: 0
      deprecated: true
```

## app/module/dts/bindings/input/zmk,input-deghost.yaml
```yaml
# Copyright (c) 2026 The ZMK Contributors
# SPDX-License-Identifier: MIT

description: |
  Deghosting wrapper around another matrix-style input device.

  Observes ABS_X/ABS_Y/BTN_TOUCH events from the upstream input device and
  re-emits only the key events that are not part of a ghosting rectangle
  (three keys pressed at the corners of a rectangle would otherwise cause
  the fourth to appear pressed on a 2KRO matrix). Ghosted presses are
  suppressed and re-emitted later when the rectangle breaks.

  Point the chosen `zmk,matrix-input` (or a physical layout's `input`
  property) at this node rather than the raw matrix input.

compatible: "zmk,input-deghost"

include: base.yaml

properties:
  input:
    type: phandle
    required: true
    description: Upstream input device whose events are deghosted.
  rows:
    type: int
    description: |
      Matrix rows. If omitted, taken from the `rows` property of `transform`.
  columns:
    type: int
    description: |
      Matrix columns. If omitted, taken from the `columns` property of
      `transform`.
  transform:
    type: phandle
    description: |
      Optional matrix transform. When present, deghosting only considers
      positions that exist in the transform's map; keys absent from the
      physical layout are ignored when looking for ghost rectangles.
```

## app/module/dts/bindings/input/zmk,input-gpio-direct.yaml
```yaml
# Copyright (c) 2026 The ZMK Contributors
# SPDX-License-Identifier: MIT

description: |
  Direct GPIO keyboard input device.

  Reports key state as Zephyr input events:
    INPUT_EV_ABS / INPUT_ABS_X     = key index (column)
    INPUT_EV_ABS / INPUT_ABS_Y     = 0 (row)
    INPUT_EV_KEY / INPUT_BTN_TOUCH = pressed/released (sync)

compatible: "zmk,input-gpio-direct"

include: base.yaml

properties:
  input-gpios:
    type: phandle-array
    required: false
  input-keys:
    type: phandles
    required: false
    description: List of gpio-key references
  debounce-period:
    type: int
    required: false
    deprecated: true
    description: Deprecated. Use debounce-press-ms and debounce-release-ms instead.
  debounce-press-ms:
    type: int
    default: 5
    description: Debounce time for key press in milliseconds. Use 0 for eager debouncing.
  debounce-release-ms:
    type: int
    default: 5
    description: Debounce time for key release in milliseconds.
  debounce-scan-period-ms:
    type: int
    default: 1
    description: Time between reads in milliseconds when any key is pressed.
  poll-period-ms:
    type: int
    default: 10
    description: Time between reads in milliseconds when no key is pressed and ZMK_INPUT_DIRECT_POLLING is enabled.
  toggle-mode:
    type: boolean
    description: Enable toggle-switch mode.
```

## app/module/dts/bindings/input/zmk,input-gpio-matrix.yaml
```yaml
# Copyright (c) 2026 The ZMK Contributors
# SPDX-License-Identifier: MIT

description: |
  GPIO keyboard matrix input device.

  Reports key state as Zephyr input events:
    INPUT_EV_ABS / INPUT_ABS_X  = column
    INPUT_EV_ABS / INPUT_ABS_Y  = row
    INPUT_EV_KEY / INPUT_BTN_TOUCH = pressed/released (sync)

compatible: "zmk,input-gpio-matrix"

include: base.yaml

properties:
  row-gpios:
    type: phandle-array
    required: true
  col-gpios:
    type: phandle-array
    required: true
  debounce-period:
    type: int
    required: false
    deprecated: true
    description: Deprecated. Use debounce-press-ms and debounce-release-ms instead.
  debounce-press-ms:
    type: int
    default: 5
    description: Debounce time for key press in milliseconds. Use 0 for eager debouncing.
  debounce-release-ms:
    type: int
    default: 5
    description: Debounce time for key release in milliseconds.
  debounce-scan-period-ms:
    type: int
    default: 1
    description: Time between reads in milliseconds when any key is pressed.
  poll-period-ms:
    type: int
    default: 10
    description: Time between reads in milliseconds when no key is pressed and ZMK_INPUT_MATRIX_POLLING is enabled.
  diode-direction:
    type: string
    default: row2col
    enum:
      - row2col
      - col2row
```

## app/module/dts/bindings/input/zmk,input-mock.yaml
```yaml
# Copyright (c) 2024 The ZMK Contributors
# SPDX-License-Identifier: MIT

description: |
  Allows defining a mock input driver that simulates periodic input events.

compatible: "zmk,input-mock"

properties:
  event-startup-delay:
    type: int
    default: 0
    description: Milliseconds to delay before starting generating the events
  event-period:
    type: int
    default: 0
    description: Default milliseconds between each sync event, used when per-event delay is 0
  events:
    type: array
    description: List of tuples of (type, code, value, sync, delay_ms)
  exit-after:
    type: boolean
```

## app/module/dts/bindings/kscan/zmk,kscan-gpio-adc.yaml
```yaml
# Copyright (c) 2020, Pete Johanson
# SPDX-License-Identifier: MIT

description: GPIO keyboard ADC controller

compatible: "zmk,kscan-gpio-adc"

include: kscan.yaml

properties:
  io-channels:
    required: true
    description: Single ADC channel coming from the Mux.
  mux-enable-gpios:
    type: phandle-array
    description: Mux enable pin.
  adc-gpios:
    type: phandle-array
    required: true
    description: Mux select pins. Only exactly 3 supported.
  col-gpios:
    type: phandle-array
    required: true
  debounce-period:
    type: int
    required: false
    deprecated: true
    description: Deprecated. Use debounce-press-ms and debounce-release-ms instead.
  debounce-press-ms:
    type: int
    default: 5
    description: Debounce time for key press in milliseconds. Use 0 for eager debouncing.
  debounce-release-ms:
    type: int
    default: 5
    description: Debounce time for key release in milliseconds.
  debounce-scan-period-ms:
    type: int
    default: 1
    description: Time between reads in milliseconds when any key is pressed.
  poll-period-ms:
    type: int
    default: 10
    description: Time between reads in milliseconds when no key is pressed and ZMK_KSCAN_MATRIX_POLLING is enabled.
```

## app/west.yml
```yaml
manifest:
  remotes:
    - name: zephyrproject-rtos
      url-base: https://github.com/zephyrproject-rtos
    - name: zmkfirmware
      url-base: https://github.com/zmkfirmware
    - name: FrameworkComputer
      url-base: git@github.com:FrameworkComputer
  projects:
    - name: zephyr-private
      path: zephyr
      remote: FrameworkComputer
      revision: d6616a2d742137c80bf1cab84511ca761486884e
      clone-depth: 1
      import:
        name-blocklist:
          - ci-tools
          - hal_altera
          - hal_cypress
          - hal_infineon
          - hal_microchip
          - hal_nxp
          - hal_openisa
          - hal_xtensa
          - hal_st
          - hal_ti
          - loramac-node
          - mcuboot
          - mcumgr
          - net-tools
          - openthread
          - edtt
          - trusted-firmware-m
    - name: hal_stm32
      revision: 4fcc3a3f32abe1c4cb76d9d1cef967728dd03908
      path: modules/hal/stm32
      remote: zmkfirmware
      groups:
        - hal
    - name: lvgl
      revision: f1db87ee98f1810328a8419572fa42a3b5f352ae
      path: modules/lib/gui/lvgl
      remote: zmkfirmware
    - name: zmk-studio-messages
      revision: 6cb4c283e76209d59c45fbcb218800cd19e9339d
      path: modules/msgs/zmk-studio-messages
      remote: zmkfirmware
    - name: zephyr-hid-touchpad-module
      revision: 4b95a1ad6ef389b27970177cc64520ae055b4cc2
      remote: FrameworkComputer
  group-filter: [+optional]
  self:
    west-commands: scripts/west-commands.yml
```
